## devices/ESP32S3/components/audio_pipeline/Kconfig
```kconfig
menu "Audio Pipeline"

    config AUDIO_PIPELINE_ENABLE_AFE
        bool "Enable Audio Front End (AFE)"
        default n
        help
            Enable the esp-sr Audio Front End before Opus encoding.
            When disabled, microphone PCM bypasses AFE and is encoded directly.
            When enabled, the existing VC and HIGH_PERF AFE configuration is used.

endmenu
```

## devices/ESP32S3/components/board_hal/Kconfig
```kconfig
menu "Board Selection"
    choice BOARD_TYPE
        prompt "Select target board"
        default BOARD_STICK_S3
        help
            Choose between M5Stack StickS3 (original) and 立创实战派 ESP32-S3.

    config BOARD_STICK_S3
        bool "M5Stack StickS3"
        select BOARD_HAS_SECONDARY_BUTTON
        select BOARD_HAS_DEEP_SLEEP

    config BOARD_LICHUANG
        bool "立创实战派 ESP32-S3"
    endchoice

    config BOARD_HAS_SECONDARY_BUTTON
        bool

    config BOARD_HAS_DEEP_SLEEP
        bool
endmenu
```

## devices/ESP32S3/sdkconfig.defaults
```kconfig
CONFIG_IDF_TARGET="esp32s3"
CONFIG_ESPTOOLPY_FLASHMODE_QIO=y
CONFIG_ESPTOOLPY_FLASHSIZE_16MB=y
CONFIG_ESPTOOLPY_FLASHSIZE="16MB"
CONFIG_PARTITION_TABLE_CUSTOM=y
CONFIG_PARTITION_TABLE_CUSTOM_FILENAME="partitions.csv"
CONFIG_PARTITION_TABLE_FILENAME="partitions.csv"
CONFIG_BT_ENABLED=y
CONFIG_BT_NIMBLE_ENABLED=y
CONFIG_BT_NIMBLE_ROLE_PERIPHERAL=y
CONFIG_BT_NIMBLE_LOG_LEVEL_WARNING=y
CONFIG_BT_NIMBLE_MAX_CONNECTIONS=1
CONFIG_BT_NIMBLE_ATT_PREFERRED_MTU=247
CONFIG_BT_NIMBLE_MSYS_1_BLOCK_COUNT=100
CONFIG_BT_NIMBLE_MSYS_1_BLOCK_SIZE=256
CONFIG_BT_NIMBLE_MSYS_2_BLOCK_COUNT=0
CONFIG_BT_NIMBLE_MSYS_2_BLOCK_SIZE=320
CONFIG_FREERTOS_HZ=1000
CONFIG_FREERTOS_WATCHPOINT_END_OF_STACK=y
CONFIG_PM_ENABLE=y
CONFIG_FREERTOS_USE_TICKLESS_IDLE=y
CONFIG_FREERTOS_IDLE_TIME_BEFORE_SLEEP=3
# tc_iot_sdk 的 ESP HAL TLS 需要 slot 0 保留给 pthread，key 从 slot 1 开始（>1）
CONFIG_FREERTOS_THREAD_LOCAL_STORAGE_POINTERS=2
CONFIG_SPIRAM=y
CONFIG_SPIRAM_MODE_OCT=y
CONFIG_SPIRAM_SPEED_80M=y
CONFIG_SPIRAM_USE_MALLOC=y
CONFIG_LV_BUILD_EXAMPLES=n
CONFIG_LV_FONT_MONTSERRAT_10=y
CONFIG_LV_FONT_MONTSERRAT_12=y
CONFIG_LV_FONT_MONTSERRAT_14=y
CONFIG_LV_FONT_MONTSERRAT_16=y
CONFIG_LV_FONT_DEFAULT_MONTSERRAT_14=y

CONFIG_BT_CTRL_MODEM_SLEEP=y
CONFIG_BT_CTRL_MAIN_XTAL_PU_DURING_LIGHT_SLEEP=y

CONFIG_FATFS_LFN_HEAP=y
CONFIG_FATFS_CODEPAGE_936=y
CONFIG_FATFS_API_ENCODING_UTF_8=y
CONFIG_FATFS_FS_EXFAT=y

# esp-sr 降噪
CONFIG_USE_ESP_SR=y
CONFIG_ESP_SR_MODEL_IN_FLASH_PARTITION=y
CONFIG_MODEL_IN_SPIFFS=y
# 降噪用 NSNET2 AI 模型（WebRTC NS 处理吞吐不足会掉速一半导致颤音）
CONFIG_SR_NSN_NSNET2=y
# CONFIG_SR_NSN_WEBRTC is not set

# console 走 UART（USB-UART 桥接 /dev/cu.wchusbserial*），不用 USB Serial/JTAG
CONFIG_ESP_CONSOLE_UART_DEFAULT=y

# BLE/NimBLE 内存放 PSRAM 腾出内部 RAM 给 esp-sr AFE 与 audio_task 栈
CONFIG_BT_NIMBLE_MEM_ALLOC_MODE_EXTERNAL=y
CONFIG_NIMBLE_MEM_ALLOC_MODE_EXTERNAL=y
# 小于阈值才走内部 RAM，其余走 PSRAM
CONFIG_SPIRAM_MALLOC_ALWAYSINTERNAL=64
CONFIG_VIDEO_PROCESSOR_ENABLE=n
```
